## components/sacdm_manager/Kconfig.projbuild
```kconfig
menu "Project SACDM Config"

    # config ESP_WIFI_SSID
    #     string "WiFi SSID"
    #     default "ESPTest"
    #     help
    #         SSID (network name) for the example to connect to.

    # config ESP_WIFI_PASSWORD
    #     string "WiFi Password"
    #     default "esp32_123"
    #     help
    #         WiFi password (WPA or WPA2) for the example to use.

    config SACDM_SAMPLE_SIZE
        int "Sample Rate"
        default 500
        help
            Number of MPU data collets in 1 second. This determine the density of SAC-DM results.

endmenu
```

## components/supabase_client/Kconfig.projbuild
```kconfig
menu "Project Supabase Config"

    config TABLE_URL
        string "Table URL"
        help
            Link to table URL from database.

    config API_KEY
        string "API Key"
        help
            API Key to access and perform operations on a specific database table

endmenu
```
